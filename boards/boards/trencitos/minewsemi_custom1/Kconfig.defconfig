## boards/boards/trencitos/minewsemi_custom1/Kconfig.defconfig
```kconfig
if BOARD_MINEWSEMI_CUSTOM1_NRF54L15_CPUAPP

# apparently not valid anymore
#config BT_CTLR
#	default BT

config ROM_START_OFFSET
	default 0x800 if BOOTLOADER_MCUBOOT

endif # BOARD_MINEWSEMI_CUSTOM1_NRF54L15_CPUAPP
```

## boards/boards/trencitos/minewsemi_custom1/Kconfig.minewsemi_custom1
```kconfig
config BOARD_MINEWSEMI_CUSTOM1
	select SOC_NRF54L15_CPUAPP if BOARD_MINEWSEMI_CUSTOM1_NRF54L15_CPUAPP
	select SOC_NRF54L15_CPUFLPR if \
		BOARD_MINEWSEMI_CUSTOM1_NRF54L15_CPUFLPR || \
		BOARD_MINEWSEMI_CUSTOM1_NRF54L15_CPUFLPR_XIP
```

## boards/boards/trencitos/minewsemi_custom1/board.yml
```yaml
board:
  name: minewsemi_custom1
  vendor: trencitos
  socs:
  - name: nrf54l15
    variants:
    - name: xip
      cpucluster: cpuflpr
```

## boards/nrf52840dongle_nrf52840.conf
```kconfig
CONFIG_BUILD_OUTPUT_HEX=y
CONFIG_BOOTLOADER_MCUBOOT=y
CONFIG_MOTOR_DRIVER_TB67=y
```

## drivers/motor/Kconfig
```kconfig
menuconfig DC_MOTOR
    bool "DC Motor drivers"
    default y
    help
      Enable DC motor driver support

if DC_MOTOR

config MOTOR_INIT_PRIORITY
    int "Motor init priority"
    default 90
    help
      Device driver initialization priority.

config MOTOR_LOG_LEVEL
    int "Motor Log Level"
    default 3
    help
      Set the log level for motor drivers.

config MOTOR_TB67H453
    bool "Toshiba TB67H453 Motor Driver"
    default n
    depends on PWM
    help
      Enable support for Toshiba TB67H453 driver (PWM + Sleep Pin)

config MOTOR_TB67H450
    bool "Toshiba TB67H450 Motor Driver"
    default n
    depends on PWM
    help
      Enable support for Toshiba TB67H450 driver (Pure PWM H-Bridge)

config MOTOR_DUMMY
    bool "Dummy Motor Driver"
    default y if !MOTOR_TB67H453 && !MOTOR_TB67H450
    help
      Enable support for Dummy Motor driver (No-op)

endif
```
